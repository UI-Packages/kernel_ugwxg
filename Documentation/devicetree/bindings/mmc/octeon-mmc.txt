## Documentation/devicetree/bindings/mmc/octeon-mmc.txt
```
* OCTEON SD/MMC Host Controller

This controller is present on some members of the Cavium OCTEON SoC
family, provide an interface for eMMC, MMC and SD devices.  There is a
single controller that may have several "slots" connected.  These
slots appear as children of the main controller node.

Required properties:
- compatible : Should be "cavium,octeon-6130-mmc"
- reg : Two entries:
	1) The base address of the MMC controller register bank.
	2) The base address of the MMC DMA engine register bank.
- interrupts : Two entries:
	1) The MMC controller interrupt line.
	2) The MMC DMA engine interrupt line.
- #address-cells : Must be <1>
- #size-cells : Must be <0>

Required properties of child nodes:
- compatible : Should be "cavium,octeon-6130-mmc-slot".
- reg : The slot number.
- cavium,bus-max-width : The number of data lines present in the slot.
- spi-max-frequency : The maximum operating frequency of the slot.

Optional properties of child nodes:
- cd-gpios : Specify GPIOs for card detection
- wp-gpios : Specify GPIOs for write protection
- power-gpios : Specify GPIOs for power control

Example:
	mmc@1180000002000 {
		compatible = "cavium,octeon-6130-mmc";
		reg = <0x11800 0x00002000 0x0 0x100>,
		      <0x11800 0x00000168 0x0 0x20>;
		#address-cells = <1>;
		#size-cells = <0>;
		/* EMM irq, DMA irq */
		interrupts = <1 19>, <0 63>;

		/* The board only has a single MMC slot */
		mmc-slot@0 {
			compatible = "cavium,octeon-6130-mmc-slot";
			reg = <0>;
			spi-max-frequency = <20000000>;
			/* bus width can be 1, 4 or 8 */
			cavium,bus-max-width = <8>;
			cd-gpios = <&gpio 9 0>;
			wp-gpios = <&gpio 10 0>;
			power-gpios = <&gpio 8 0>;
		};
	};
```

## Documentation/devicetree/bindings/pci/cavium,thunder-pci.txt
```
* Cavium Thunder PCIe interface

Required properties:
- compatible: should contain "cavium,thunder-pcie" to identify the core.
- device_type: set to "pci"
- #address-cells: set to <3>
- #size-cells: set to <2>
- #stream-id-cells: set to <1>
- bus-range: PCI bus numbers covered
- reg: base address and length of the pcie configuration space.
- ranges: ranges for the PCI memory regions.
- msi-parent: Link to the hardware entity that serves as the Message
  Signaled Interrupt controller for this PCI controller.

Example:

SoC specific DT Entry:

	pcie0: pcie0@0x848000000000 {
		compatible = "cavium,thunder-pcie";
		device_type = "pci";
		msi-parent = <&its>;
		bus-range = <0 255>;
		#size-cells = <2>;
		#address-cells = <3>;
		#stream-id-cells = <1>;
		reg = <0x8480 0x00000000 0 0x10000000>;  /* Configuration space */
		ranges = <0x03000000 0x8010 0x00000000 0x8010 0x00000000 0x70 0x00000000>, /* mem */
			<0x03000000 0x8300 0x00000000 0x8300 0x00000000 0x80 0x00000000>,
			<0x03000000 0x87e0 0x00000000 0x87e0 0x00000000 0x01 0x00000000>;
	};
```

## Documentation/devicetree/bindings/video/exynos/mipi-dsi.txt
```
* Samsung Exynos MIPI-DSI bindings

Properties for MIPI-DSI node ::
===============================
- compatible: should be "samsung,exynos-mipi"

- reg: should contain mipi-dsi physical address location and length.

- interrupts: should contain mipi-dsi interrupt number

- enabled: Describes whether MIPI DSI got enabled in uboot

- mipi-lcd: phandle to lcd specific information. It can be anything
	specific to lcd driver.

- mipi-phy: phandle to D-PHY node.

- mipi-config: subnode for mipi config information
	- auto_flush: enable or disable Auto flush of MD FIFO using VSYNC pulse
	- eot_disable: enable or disable EoT packet in HS mode
	- auto_vertical_cnt: specifies auto vertical count mode.
		In Video mode, the vertical line transition uses line counter
		configured by VSA, VBP, and Vertical resolution. If this bit is
		set to '1', the line counter does not use VSA and VBP registers.
		In command mode, this property is ignored.
	- hse: set horizontal sync event mode.
		In VSYNC pulse and Vporch area,	MIPI DSI master transfers only
		HSYNC start packet to MIPI DSI slave at MIPI DSI spec1.1r02.
		This bit transfers HSYNC end packet in VSYNC pulse and Vporch
		area. In command mode, this property is ignored.
	- hfp: specifies HFP disable mode.
		If this property is set, DSI master ignores HFP area in
		VIDEO mode. In command mode, this property is ignored.
	- hbp: specifies HBP disable mode.
		If this property is set, DSI master ignores HBP area in
		VIDEO mode. In command mode, this property is ignored.
	- hsa: specifies HSA disable mode.
		If this property is set, DSI master ignores HSA area in
		VIDEO mode. In command mode, this property is ignored.
	- cmd_allow: specifies the number of horizontal lines, where command
		packet transmission is allowed after Stable VFP period.
	- e_interface: specifies interface to be used.(CPU or RGB interface)
	- e_virtual_ch: specifies virtual channel number that main or
		sub display uses.
	- e_pixel_format: specifies pixel stream format for main or sub display.
	- e_burst_mode: selects Burst mode in Video mode.
		In Non-burst mode, RGB data area is filled with RGB data
		and NULL packets, according to input bandwidth of RGB interface.
		In Burst mode, RGB data area is filled with RGB data only.
	- e_no_data_lane: specifies data lane count to be used by Master.
	- e_byte_clk: select byte clock source. (it must be DSIM_PLL_OUT_DIV8)
		DSIM_EXT_CLK_DIV8 and DSIM_EXT_CLK_BYPASSS are not supported.
	- pll_stable_time: specifies the PLL Timer for stability of the
		generated clock(System clock cycle base). If the timer value
		goes to 0x00000000, the clock stable bit of status and interrupt
		register is set.
	- esc_clk: specifies escape clock frequency for getting the escape clock
		prescaler value.
	- stop_holding_cnt: specifies the interval value between transmitting
		read packet(or write "set_tear_on" command) and BTA request.
		after transmitting read packet or write "set_tear_on" command,
		BTA requests to D-PHY automatically. this counter value
		specifies the interval between them.
	- bta_timeout: specifies the timer for BTA.
		this register specifies time out from BTA request to change
		the direction with respect to Tx escape clock.
	- rx_timeout: specifies the timer for LP Rx mode timeout.
		this register specifies time out on how long RxValid deasserts,
		after RxLpdt asserts with respect to Tx escape clock.
		- RxValid specifies Rx data valid indicator.
		- RxLpdt specifies an indicator that D-PHY is under RxLpdt mode.
		- RxValid and RxLpdt specifies signal from D-PHY.

- panel-info: timing information from the panel used.
	- lcd-htiming : xres, left_margin, right_margin, hsync-len info
	- lcd-vtiming : yres, upper_margin, lower_margin, vsync-len info

Properties for D-PHY node ::
=============================
	Instead of passing D-PHY related callbacks as part of platform data,
we can pass the phy nodes to the mipi driver. Depending on the type of PHY
settings, we can implement multiple PHY node types and corresponding
enable/disable/reset callbacks in the driver itself. Currently we support
only one type of PHY node.

D-PHY node type1:
------------------
- compatible: "samsung,exynos-mipi-phy-type1"
- reg_enable_dphy: should contain physical address location of
	D-PHY enable register
- mask_enable_dphy: should contain the mask for D-PHY enable register
- reg_reset_dsim: should contain physical address location of
	D-PHY DSIM reset register
- mask_reset_dsim: should contain the mask for D-PHY DSIM reset register

MIPI-LCD node ::
=================
	Apart from the following three properties, driver specific
properties can be sent through this node. The following example sends
some more properties for driver's use.

- lcd-name: name of the device to use with this device
- id: id of device to be registered (default -1 in case not specified)
- bus-id: bus id for identifing connected bus and this bus id should be
	same as id of mipi_dsim_device (default -1 incase not specified)

Example:
--------
	mipi_lcd: mipi-lcd@toshiba {
		lcd-name = "tc358764";
		id = <0>;
		enabled = <1>;
		reset-delay = <120>;
		power-on-delay = <25>;
		power-off-delay = <200>;
		gpio-poweron = <&gpx1 5 0 0 0>;
	};

	mipi_dsim_phy: mipi-phy@exynos5250 {
		compatible = "samsung-exynos,mipi-phy-type1";
		reg_enable_dphy = <0x10040714>;
		mask_enable_dphy = <0x00000001>;
		reg_reset_dsim = <0x10040714>;
		mask_reset_dsim = <0x00000004>;
	};

	mipi_dsi_tc358764: lcd_panel_tc358764 {
		lcd-htiming = <24 24 2 800>;
		lcd-vtiming = <1 13 2 1280>;
	};

	mipi {
		compatible = "samsung,exynos-mipi";
		reg = <0x14500000 0x10000>;
		interrupts = <0 82 0>;

		mipi-lcd = <&mipi_lcd>;
		mipi-phy = <&mipi_dsim_phy>;
		enabled = <0>;

		panel-info = <&lcd_mipi_dsi_tc358764>;
		mipi-config {
			e_interface = <1>;
			e_pixel_format = <7>;
			auto_flush = <0>;
			eot_disable = <0>;
			auto_vertical_cnt = <0>;
			hse = <0>;
			hfp = <0>;
			hbp = <0>;
			hsa = <0>;
			e_no_data_lane = <3>;
			e_byte_clk = <0>;
			e_burst_mode = <3>;
			p = <3>;
			m = <115>;
			s = <1>;
			pll_stable_time = <500>;
			esc_clk = <400000>;
			stop_holding_cnt =<0x0f>;
			bta_timeout = <0xff>;
			rx_timeout = <0xffff>;
			e_virtual_ch = <0>;
			cmd_allow = <0xf>;
		};

	};
```

## arch/mips/kvm/Kconfig
```kconfig
#
# KVM configuration
#
source "virt/kvm/Kconfig"

menuconfig VIRTUALIZATION
	bool "Virtualization"
	depends on HAVE_KVM
	---help---
	  Say Y here to get to see options for using your Linux host to run
	  other operating systems inside virtual machines (guests).
	  This option alone does not add any kernel code.

	  If you say N, all options in this submenu will be skipped and disabled.

if VIRTUALIZATION

config KVM
	tristate
	select PREEMPT_NOTIFIERS

config KVM_MIPS_TE
	tristate "Kernel-based Virtual Machine (KVM) 32-bit trap-and-emulate"
	depends on HAVE_KVM && 32BIT
	select KVM
	select ANON_INODES
	select KVM_MMIO
	---help---
	  Support for hosting Guest kernels with modified address space layout.
	  Currently supported on MIPS32 processors.

config KVM_MIPS_DYN_TRANS
	bool "KVM/MIPS: Dynamic binary translation to reduce traps"
	depends on KVM_MIPS_TE
	---help---
	  When running in Trap & Emulate mode patch privileged
	  instructions to reduce the number of traps.

	  If unsure, say Y.

config KVM_MIPS_DEBUG_COP0_COUNTERS
	bool "Maintain counters for COP0 accesses"
	depends on KVM_MIPS_TE
	---help---
	  Maintain statistics for Guest COP0 accesses.
	  A histogram of COP0 accesses is printed when the VM is
	  shutdown.

	  If unsure, say N.

config KVM_MIPS_VZ
	bool "Kernel-based Virtual Machine (KVM) using hardware MIPS-VZ support"
	depends on HAVE_KVM
	select KVM
	select EXPORT_UASM
	select HAVE_KVM_MSI
	select HAVE_KVM_IRQ_ROUTING
	select HAVE_KVM_IRQCHIP
	select HAVE_KVM_EVENTFD
	---help---
	  Support for hosting Guest kernels on hardware with the
	  MIPS-VZ hardware module.


source drivers/vhost/Kconfig

endif # VIRTUALIZATION
```

## drivers/net/ethernet/octeon/Kconfig
```kconfig
#
# Cavium network device configuration
#

config OCTEON_BGX_NEXUS
	tristate
	depends on CAVIUM_OCTEON_SOC

config OCTEON_SRIO_NEXUS
	tristate

config OCTEON_COMMON_NEXUS
	tristate

config OCTEON_BGX_PORT
	tristate
	depends on CAVIUM_OCTEON_SOC
	select OCTEON_BGX_NEXUS
	select OCTEON_COMMON_NEXUS

config OCTEON3_ETHERNET
	tristate "Cavium Inc. OCTEON III PKI/PKO Ethernet support (not cn70xx)"
	depends on CAVIUM_OCTEON_SOC
	select OCTEON_BGX_PORT
	select OCTEON_FPA3
	help
	  Support for 'BGX' Ethernet via PKI/PKO units.  No support
	  for cn70xx chips (use OCTEON_ETHERNET for cn70xx).

config OCTEON3_ETHERNET_SRIO
	tristate "Cavium Inc. SRIO support for OCTEON III Ethernet driver"
	depends on (OCTEON3_ETHERNET && CAVIUM_OCTEON_RAPIDIO)
	select OCTEON_SRIO_NEXUS
	help
	  This driver adds 'SRIO' support to the Ethernet driver via PKI/PKO
	  units. It supports Caviums CNF75XX SOC. To compile this driver as a
	  module, choose M here. The module will be called
	  octeon3-ethernet-srio.

config OCTEON_ETHERNET
	tristate "Cavium Inc. OCTEON Ethernet support"
	depends on CPU_CAVIUM_OCTEON
	select PHYLIB
	select MDIO_OCTEON
	select NET_VENDOR_OCTEON
	select OCTEON_ETHERNET_MEM
	select OCTEON_ETHERNET_COMMON
	help
	  This driver supports the builtin ethernet ports on Cavium
	  Inc.' products in the Octeon family. This driver supports the
	  CN3XXX, CN5XXX, CN6XXX and CNF7XXX OCTEON processors.

	  To compile this driver as a module, choose M here.  The module
	  will be called octeon-ethernet.

config OCTEON_ETHERNET_MEM
	tristate
	depends on CPU_CAVIUM_OCTEON

config OCTEON_POW_ONLY_ETHERNET
	tristate "POW based internal only ethernet driver"
	depends on  CPU_CAVIUM_OCTEON
	depends on  OCTEON_ETHERNET
	help
	  This option enables a very simple ethernet driver for internal core
	  to core traffic. It relies on another driver, octeon-ethernet,
	  to perform all hardware setup. This driver's purpose is to supply
	  basic networking between different Linux images running on the same
	  chip. A single core loads the octeon-ethernet module, all other cores
	  load this driver. On load, the driver waits for some other core to
	  perform hardware setup.

config OCTEON_MGMT_ETHERNET
	tristate "Octeon Management port ethernet driver (CN5XXX, CN6XXX)"
	depends on  CAVIUM_OCTEON_SOC
	select PHYLIB
	select MDIO_OCTEON
	select NET_VENDOR_OCTEON
	select OCTEON_ETHERNET_COMMON
	select OCTEON_BGX_PORT
	default y
	---help---
	  This option enables the ethernet driver for the management
	  port on Cavium Networks' Octeon CN57XX, CN56XX, CN55XX,
	  CN54XX, CN52XX, and CN6XXX chips.

config NET_VENDOR_OCTEON
	bool

config OCTEON_ETHERNET_COMMON
	tristate
```

## drivers/pci/host/Kconfig
```kconfig
menu "PCI host controller drivers"
	depends on PCI

config PCI_MVEBU
	bool "Marvell EBU PCIe controller"
	depends on ARCH_MVEBU || ARCH_KIRKWOOD

config PCIE_DW
	bool

config PCI_EXYNOS
	bool "Samsung Exynos PCIe controller"
	depends on SOC_EXYNOS5440
	select PCIEPORTBUS
	select PCIE_DW

config PCI_THUNDER_PEM
       bool

config PCI_THUNDER
	bool "Thunder PCIe host controller"
	depends on ARM64 || COMPILE_TEST
	depends on OF_PCI
	depends on PCI_MSI
	select PCI_THUNDER_PEM
	help
	  Say Y here if you want internal PCI support on Thunder SoC.
	  There are 4 internal PCI controllers available.

endmenu
```

## drivers/rapidio/devices/Kconfig
```kconfig
#
# RapidIO master port configuration
#

config RAPIDIO_TSI721
	bool "IDT Tsi721 PCI Express SRIO Controller support"
	depends on RAPIDIO && PCIEPORTBUS
	default "n"
	---help---
	  Include support for IDT Tsi721 PCI Express Serial RapidIO controller.

config RAPIDIO_CN6XXX
	tristate "Cavium Networks CN6XXX processors"
	depends on RAPIDIO
	---help---
	  Includes support for Cavium Networks CN6XXX family of serial RapidIO
	  devices.
```
